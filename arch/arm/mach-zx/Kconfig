## arch/arm/mach-zx/Kconfig
```kconfig
if ARCH_ZX

config SYS_SOC
	default "zx297520v3"

config SYS_VENDOR
	default "zx"

choice
	prompt "Sanechips board select"

config TARGET_ZX297520V3
	bool "Sanechips ZX297520V3 cursed SoC"
	select CPU_V7A
	help
	  The Sanechips ZX297520V3 is a ARM64-based SoC with cursed AArch32 mode.

endchoice

config SYS_BOARD
	string "Board name"
	default "zx297520v3" if TARGET_ZX297520V3
	default ""
	help
	  This option contains information about board name.
	  Based on this option board/<CONFIG_SYS_VENDOR>/<CONFIG_SYS_BOARD> will
	  be used.

config SYS_CONFIG_NAME
	default "zx297520v3" if TARGET_ZX297520V3

endif
```

## configs/zx297520v3_defconfig
```kconfig
CONFIG_ARM=y
CONFIG_ARCH_CPU_INIT=y
CONFIG_ARCH_ZX=y
CONFIG_SUPPORT_PASSING_ATAGS=y
# CONFIG_SETUP_MEMORY_TAGS is not set
CONFIG_TEXT_BASE=0x27EF0000
CONFIG_NR_DRAM_BANKS=1
CONFIG_DEFAULT_DEVICE_TREE="mf920u"
CONFIG_SYS_LOAD_ADDR=0x25000000
CONFIG_DEBUG_UART_BASE=0x1408000
CONFIG_DEBUG_UART_CLOCK=24000000
CONFIG_ARMV7_LPAE=y
CONFIG_DEBUG_UART=y
CONFIG_OPTIMIZE_INLINING=y
# CONFIG_EFI_LOADER is not set
# CONFIG_ANDROID_BOOT_IMAGE is not set
CONFIG_BOOTDELAY=1
# CONFIG_SYS_DEVICE_NULLDEV is not set
CONFIG_CYCLIC=y
CONFIG_BOARD_EARLY_INIT_F=y
# CONFIG_BOARD_INIT is not set
CONFIG_BOARD_LATE_INIT=y
CONFIG_HUSH_PARSER=y
# CONFIG_HUSH_OLD_PARSER is not set
CONFIG_HUSH_MODERN_PARSER=y
CONFIG_CMD_BDINFO_EXTRA=y
CONFIG_CMD_UFETCH=y
CONFIG_CMD_BOOTZ=y
# CONFIG_BOOTM_PLAN9 is not set
# CONFIG_BOOTM_RTEMS is not set
# CONFIG_BOOTM_VXWORKS is not set
CONFIG_CMD_MEMINFO=y
CONFIG_CMD_MEMINFO_MAP=y
# CONFIG_CMD_BIND is not set
CONFIG_CMD_CLK=y
CONFIG_CMD_DM=y
CONFIG_CMD_USB=y
CONFIG_CMD_TIME=y
CONFIG_CMD_HASH=y
CONFIG_OF_EMBED=y
CONFIG_DM_DEBUG=y
CONFIG_CLK=y
CONFIG_CLK_STUB=y
CONFIG_USB_FUNCTION_FASTBOOT=y
CONFIG_FASTBOOT_BUF_ADDR=0x21000000
CONFIG_FASTBOOT_OEM_RUN=y
CONFIG_FASTBOOT_OEM_BOARD=y
CONFIG_SPECIFY_CONSOLE_INDEX=y
CONFIG_DM_SERIAL=y
CONFIG_DEBUG_UART_PL011=y
CONFIG_DEBUG_UART_ANNOUNCE=y
CONFIG_DEBUG_UART_SKIP_INIT=y
CONFIG_PL01X_SERIAL=y
CONFIG_ZX29_PL011_SERIAL=y
CONFIG_TIMER=y
CONFIG_ZX29_TIMER=y
CONFIG_USB=y
CONFIG_DM_USB_GADGET=y
CONFIG_USB_DWC2=y
CONFIG_USB_GADGET=y
CONFIG_USB_GADGET_VENDOR_NUM=0x1337
CONFIG_USB_GADGET_PRODUCT_NUM=0x42
CONFIG_USB_GADGET_DWC2_OTG=y
CONFIG_USB_FUNCTION_ACM=y
CONFIG_SHA256=y
CONFIG_SHA384=y
```
